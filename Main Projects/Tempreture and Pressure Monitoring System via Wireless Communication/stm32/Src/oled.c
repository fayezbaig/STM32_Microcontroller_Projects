/*
 * oled.c - SSD1306 128x64 OLED driver (I2C, frame-buffered)
 */
#include "oled.h"

#define CTRL_CMD    0x00U   /* Co = 0, D/C# = 0 : command stream */
#define CTRL_DATA   0x40U   /* Co = 0, D/C# = 1 : data stream    */

/* 1 bit per pixel, organised in 8 pages of 128 columns (SSD1306 layout) */
static uint8_t s_fb[OLED_WIDTH * OLED_HEIGHT / 8U];

/* ------------------------------------------------------------------ */
/* 5x7 font, ASCII 0x20..0x7F. Each byte is one column, LSB = top row. */
/* Entry 0x7F is a degree sign.                                        */
/* ------------------------------------------------------------------ */
static const uint8_t font5x7[96][5] = {
    {0x00,0x00,0x00,0x00,0x00}, /* ' ' */
    {0x00,0x00,0x5F,0x00,0x00}, /* !   */
    {0x00,0x07,0x00,0x07,0x00}, /* "   */
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    {0x00,0x06,0x09,0x09,0x06}, /* 0x7F -> degree sign */
};

/* ------------------------------------------------------------------ */
/* Low level                                                           */
/* ------------------------------------------------------------------ */

static i2c_status_t send_cmds(const uint8_t *cmds, uint16_t len)
{
    return i2c_write_reg(OLED_I2C_ADDR, CTRL_CMD, cmds, len);
}

i2c_status_t oled_init(void)
{
    static const uint8_t init_seq[] = {
        0xAE,             /* display OFF                               */
        0xD5, 0x80,       /* clock divide / oscillator frequency       */
        0xA8, 0x3F,       /* multiplex ratio = 64                      */
        0xD3, 0x00,       /* display offset = 0                        */
        0x40,             /* start line = 0                            */
        0x8D, 0x14,       /* charge pump ON (internal VCC)             */
        0x20, 0x00,       /* memory addressing: horizontal             */
        0xA1,             /* segment remap: col 127 -> SEG0            */
        0xC8,             /* COM scan direction: remapped              */
        0xDA, 0x12,       /* COM pins: alternative, no remap (128x64)  */
        0x81, 0xCF,       /* contrast                                  */
        0xD9, 0xF1,       /* pre-charge period                         */
        0xDB, 0x40,       /* VCOMH deselect level                      */
        0xA4,             /* display follows RAM                       */
        0xA6,             /* normal (not inverted)                     */
        0x2E,             /* scrolling off                             */
        0xAF              /* display ON                                */
    };

    i2c_status_t st = send_cmds(init_seq, sizeof init_seq);
    if (st != I2C_OK) return st;

    oled_clear();
    return oled_update();
}

i2c_status_t oled_update(void)
{
    static const uint8_t window[] = {
        0x21, 0x00, OLED_WIDTH - 1U,            /* column range 0..127 */
        0x22, 0x00, (OLED_HEIGHT / 8U) - 1U     /* page range 0..7     */
    };

    i2c_status_t st = send_cmds(window, sizeof window);
    if (st != I2C_OK) return st;

    /* Whole frame in one transaction: control byte 0x40 + 1024 data bytes.
     * ~27 ms at 380 kHz. */
    return i2c_write_reg(OLED_I2C_ADDR, CTRL_DATA, s_fb, sizeof s_fb);
}

/* ------------------------------------------------------------------ */
/* Drawing (RAM buffer only)                                           */
/* ------------------------------------------------------------------ */

void oled_clear(void)
{
    for (uint16_t i = 0; i < sizeof s_fb; i++) {
        s_fb[i] = 0;
    }
}

void oled_set_pixel(uint8_t x, uint8_t y, uint8_t on)
{
    if (x >= OLED_WIDTH || y >= OLED_HEIGHT) return;

    const uint16_t idx = (uint16_t)(x + (uint16_t)(y >> 3) * OLED_WIDTH);
    const uint8_t  bit = (uint8_t)(1U << (y & 7U));

    if (on) s_fb[idx] |= bit;
    else    s_fb[idx] &= (uint8_t)~bit;
}

void oled_hline(uint8_t x, uint8_t y, uint8_t w)
{
    for (uint8_t i = 0; i < w; i++) {
        oled_set_pixel((uint8_t)(x + i), y, 1);
    }
}

void oled_draw_char(uint8_t x, uint8_t y, char c, uint8_t scale)
{
    uint8_t code = (uint8_t)c;
    if (code < 0x20U || code > 0x7FU) code = '?';
    if (scale == 0U) scale = 1U;

    const uint8_t *glyph = font5x7[code - 0x20U];

    for (uint8_t col = 0; col < 5U; col++) {
        uint8_t bits = glyph[col];
        for (uint8_t row = 0; row < 7U; row++) {
            if (bits & (1U << row)) {
                for (uint8_t dx = 0; dx < scale; dx++) {
                    for (uint8_t dy = 0; dy < scale; dy++) {
                        oled_set_pixel((uint8_t)(x + col * scale + dx),
                                       (uint8_t)(y + row * scale + dy), 1);
                    }
                }
            }
        }
    }
}

void oled_draw_string(uint8_t x, uint8_t y, const char *s, uint8_t scale)
{
    if (scale == 0U) scale = 1U;
    while (*s) {
        if (x + 5U * scale > OLED_WIDTH) break;    /* clip at right edge */
        oled_draw_char(x, y, *s++, scale);
        x = (uint8_t)(x + 6U * scale);
    }
}

uint8_t oled_text_width(const char *s, uint8_t scale)
{
    uint16_t n = 0;
    while (s[n]) n++;
    if (n == 0U) return 0;
    if (scale == 0U) scale = 1U;
    const uint16_t w = (uint16_t)(n * 6U * scale - scale);   /* no gap after last */
    return (w > 255U) ? 255U : (uint8_t)w;
}
